


const unsigned char epd_bitmap_nerf [] PROGMEM = {
  0x00, 0x00, 0x00, 0x00, 0x00, 0x00, 0x00, 0x00, 0x00, 0x00, 0x0f, 0xff, 0xc0, 0x00, 0x00, 0x00, 
  0x00, 0x00, 0x00, 0x00, 0x00, 0x00, 0x00, 0x00, 0x00, 0x0f, 0xff, 0xff, 0xff, 0x80, 0x00, 0x00, 
  0x00, 0x00, 0x00, 0x00, 0x00, 0x00, 0x00, 0x00, 0x03, 0xff, 0xff, 0xff, 0xff, 0xf8, 0x00, 0x00, 
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  0x00, 0x00, 0x00, 0x00, 0x03, 0xff, 0xc0, 0x00, 0x00, 0x00, 0x00, 0x00, 0x00, 0x00, 0x00, 0x00
};
//const unsigned char epd_bitmap_nerf [] PROGMEM = { //assume exists, too long to paste
const unsigned char *epd_bitmap_logos[] PROGMEM = {
    epd_bitmap_nerf,
    // add more logo pointers here
};

#include <Wire.h>
#include <Adafruit_SSD1306.h>
#include "pico/multicore.h"

class Oled {
  public:
    Oled() : display(SCREEN_WIDTH, SCREEN_HEIGHT, &Wire, OLED_RESET) {}

    void begin() {
      Wire.setSDA(8);
      Wire.setSCL(9);
      Wire.begin();
      display.begin(SSD1306_SWITCHCAPVCC, 0x3C);
      display.setTextSize(1);
      display.setTextColor(SSD1306_WHITE);
      display.clearDisplay();

      multicore_reset_core1();
      delay(10);//stability
      multicore_launch_core1(core1_entry);  // start core 1
    }

    void display_startup_info() { 
      display_mode = 1;   
      ready_to_display = true;
    }
    void display_logo(uint8_t index = 0) {
      logo_index = index;
      display_mode = 2;
      ready_to_display = true;
    }
    void display_low_voltage(String s) { 
      low_voltage_msg = s;  
      display_mode = 3;
      ready_to_display = true;
    }
    void display_empty() {
      display_mode = 4;
      ready_to_display = true;
    }
    void display_mag(uint16_t darts) {
      mag_darts = darts;
      display_mode = 5;
      ready_to_display = true;
    }
    void display_stats(const data_t &data, float voltage) {
      stats_data = data;
      stats_voltage = voltage;
      display_mode = 6;
      ready_to_display = true;
    }
    void display_menu(const data_t &data, uint8_t selected_setting) {
      menu_data = data;
      menu_selected_setting = selected_setting;
      display_mode = 7;
      ready_to_display = true;
    }

    static Oled instance;

  private:
    static constexpr uint8_t SCREEN_WIDTH = 128;
    static constexpr uint8_t SCREEN_HEIGHT = 64;
    static constexpr int8_t OLED_RESET = -1;

    Adafruit_SSD1306 display;
    volatile bool ready_to_display = false;
    volatile uint8_t display_mode = 0;  // Flag to determine what to display
    String low_voltage_msg = "";  // Use String without namespace for compatibility
    volatile uint8_t logo_index = 0;
    volatile uint16_t mag_darts = 0;
    volatile float stats_voltage = 0.0f;
    data_t stats_data;  // make sure data_t is trivially copyable or consider making a deep copy manually
    data_t menu_data;
    volatile uint8_t menu_selected_setting = 0;



    void update_display() {
      if (!ready_to_display) return;

      display.clearDisplay();
      display.setTextSize(1);
      display.setTextColor(SSD1306_WHITE);

      // Display based on current mode
      switch (display_mode) {
        case 1: display_startup_info_core1(); break;
        case 2: display_logo_core1(); break;
        case 3: display_low_voltage_core1(); break;
        case 4: display_empty_core1(); break;
        case 5: display_mag_core1(); break;
        case 6: display_stats_core1(); break;
        case 7: display_menu_core1(); break;
      }

      display.display();
      ready_to_display = false;
    }

    static void core1_entry() {
      instance.run();
    }

    void run() {
      while (true) {
        update_display();
        sleep_ms(10);  //adjust as needed
      }
    }

    void display_startup_info_core1() {
      display.setTextSize(1);
      String line1 = "Made by Valkor";
      String line2 = "SN#0001";

      int x1 = (SCREEN_WIDTH - (line1.length() * 6)) / 2;
      int x2 = (SCREEN_WIDTH - (line2.length() * 6)) / 2;

      display.setCursor(x1, 5);
      display.println(line1);

      display.setCursor(x2, 17);
      display.println(line2);
    }

    void display_logo_core1() {
      display.drawBitmap(0, 0, epd_bitmap_logos[logo_index], 128, 60, SSD1306_WHITE);
    }

    void display_low_voltage_core1() {  // Remove the parameter here
      display.setTextSize(2);  // Larger text for "BATT LOW"
      display.setCursor(20, 7);
      display.println("BATT LOW");

      int x = (SCREEN_WIDTH - (low_voltage_msg.length() * 12)) / 2;
      display.setCursor(x, 35);
      display.println(low_voltage_msg);  // Use the stored message
    }

    void display_empty_core1() {
      display.setTextSize(3); // 18x24 font
      display.setCursor(24, 21);
      display.println("EMPTY");
    }

    void display_mag_core1() {
      display.setTextSize(8); // 30x40 font

      if (mag_darts < 10) {
        display.setCursor(46, 3);
      } else if (mag_darts < 100){
        display.setCursor(20, 3);
      }else if (mag_darts < 1000){
        display.setTextSize(7);
        display.setCursor(0, 10);
      }else if (mag_darts < 10000){
        display.setTextSize(5);
        display.setCursor(0, 15);
      }

      display.println(mag_darts);
    }

    void display_stats_core1() {
      display.setTextSize(1);  // 6x8 font

      display.setCursor(2, 2);
      display.println(String(stats_voltage) + "v  (" + String(stats_voltage / 4.0f) + "v/cell");

      display.setCursor(2, 12);
      display.println("DL=" + String(darts_launched) + " ATDL=" + String(stats_data.all_time_darts_launched));

      display.setCursor(2, 23);
      display.println(String(SERIAL_NUMBER) + "  " + String(SOFTWARE_VERSION));

      display.setCursor(2, 34);
      display.println("Made by Valkor");

      if (stats_data.failed_login_attempts > 0) {
        display.setCursor(2, 45);
        display.println("FLA=" + String(stats_data.failed_login_attempts));
      }
    }

    void print_menu_item(uint8_t row, const String &label, const String &value, bool selected) {
      display.setCursor(2, 2 + row * 11);  // 11 px spacing per row
      display.print(selected ? "   > " : "     ");
      display.print(label + " = " + value);
      if (selected) display.print(" <");
    }


    void display_menu_core1() {
      display.setTextSize(1);  // 6x8 font

      print_menu_item(0, "volley", String(menu_data.volley), menu_selected_setting == 0);
      print_menu_item(1, "pwr_a", String(menu_data.power_a), menu_selected_setting == 1);
      print_menu_item(2, "pwr_b", String(menu_data.power_b), menu_selected_setting == 2);
      print_menu_item(3, "pwr_q", String(menu_data.power_q), menu_selected_setting == 3);
      print_menu_item(4, "DD", String(menu_data.dart_detection), menu_selected_setting == 4);
      print_menu_item(5, "UV", String(menu_data.uv), menu_selected_setting == 5);
    }


  
};

Oled Oled::instance;


/*
void generate_random_digits(uint8_t *buffer, size_t len) {
    for (size_t i = 0; i < len; i++) {
        buffer[i] = random(0, 10); // generates 0–9
    }
  }
*/