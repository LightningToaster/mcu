#include <Wire.h>
#include <Adafruit_SSD1306.h>

//'nerf', 128x60px
const unsigned char epd_bitmap_nerf [] PROGMEM = {
  0x00, 0x00, 0x00, 0x00, 0x00, 0x00, 0x00, 0x00, 0x00, 0x00, 0x0f, 0xff, 0xc0, 0x00, 0x00, 0x00, 
  0x00, 0x00, 0x00, 0x00, 0x00, 0x00, 0x00, 0x00, 0x00, 0x0f, 0xff, 0xff, 0xff, 0x80, 0x00, 0x00, 
  0x00, 0x00, 0x00, 0x00, 0x00, 0x00, 0x00, 0x00, 0x03, 0xff, 0xff, 0xff, 0xff, 0xf8, 0x00, 0x00, 
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  0x00, 0x00, 0x00, 0x00, 0x03, 0xff, 0xc0, 0x00, 0x00, 0x00, 0x00, 0x00, 0x00, 0x00, 0x00, 0x00
};

const unsigned char *epd_bitmap_logos[] PROGMEM = {
    epd_bitmap_nerf,
    // add more logo pointers here
};


class Oled {
  private:
    static constexpr uint8_t SCREEN_WIDTH = 128;
    static constexpr uint8_t SCREEN_HEIGHT = 64;
    static constexpr uint8_t OLED_RESET = -1;
    Adafruit_SSD1306 display;

  public:
    Oled() : display(SCREEN_WIDTH, SCREEN_HEIGHT, &Wire, OLED_RESET) {}

    void begin() {
      Wire.setSDA(8);
      Wire.setSCL(9);
      Wire.begin();

      display.begin(SSD1306_SWITCHCAPVCC, 0x3C);
      display.setTextSize(1);
      display.setTextColor(SSD1306_WHITE);
      display.clearDisplay();
    }//begin


  void display_startup_info(){
    display.clearDisplay();
    display.setTextSize(1); // 6x8 font
    display.setTextColor(SSD1306_WHITE);

    String line1 = "Made by Valkor";
    String line2 = "SN#0001";

    int x1 = (SCREEN_WIDTH - (line1.length() * 6)) / 2;
    int x2 = (SCREEN_WIDTH - (line2.length() * 6)) / 2;

    display.setCursor(x1, 5);
    display.println(line1);

    display.setCursor(x2, 17);
    display.println(line2);

    display.display();
  }

  void generate_random_digits(uint8_t *buffer, size_t len) {
    for (size_t i = 0; i < len; i++) {
        buffer[i] = random(0, 10); // generates 0–9
    }
  }

  void display_logo(uint8_t index = 0){
    display.clearDisplay();
    display.drawBitmap(0, 0, epd_bitmap_logos[index], 128, 60, SSD1306_WHITE);
    display.display();
  }

  void display_empty(){
    display.clearDisplay();
    display.setTextSize(3); // 18x24 font
    display.setCursor(24, 21);
    display.println("EMPTY");
    display.display();
  }

  void display_low_voltage(String s){
    display.clearDisplay();
    display.setTextSize(2); // 12x16 font
    display.setCursor(20, 7);
    display.println("BATT LOW");
    int x = (SCREEN_WIDTH - (s.length() * 12)) / 2;
    display.setCursor(x, 35);
    display.println(s);
    display.display();
  }

  void display_mag(uint8_t darts) {//TODO 11 is shorter etc, may need hardcoded offsets
    display.clearDisplay();
    display.setTextSize(8);  // 30x40 font
    if (darts < 10){
      display.setCursor(46, 3);
    }else{
      display.setCursor(20, 3);
    }
    
    display.println(darts);  // use string for consistent width
    display.display();
  }

  void print_menu_item(uint8_t row, const String &label, const String &value, bool selected) {
    display.setCursor(2, 2 + row * 11);  // 11 px spacing per row
    if (selected) display.print("   > ");
    else display.print("     ");
    display.print(label + " = " + value);
    if (selected) display.print(" <");
  }

  void display_menu(const data_t &data, uint8_t selected_setting) {
    display.clearDisplay();
    display.setTextSize(1);  // 6x8 font

    print_menu_item(0, "volley", String(data.volley), selected_setting == 0);
    print_menu_item(1, "pwr_a", String(data.power_a), selected_setting == 1);
    print_menu_item(2, "pwr_b", String(data.power_b), selected_setting == 2);
    print_menu_item(3, "pwr_q", String(data.power_q), selected_setting == 3);
    print_menu_item(4, "DD", String(data.dart_detection), selected_setting == 4);
    print_menu_item(5, "UV", String(data.uv), selected_setting == 5);

    display.display();
  }

  void display_stats(const data_t &data, float voltage) {
    display.clearDisplay();
    display.setTextSize(1);  // 6x8 font
    display.setCursor(2, 2);display.println(String(voltage) + "v  (" + String(voltage/4) + "v/cell"); 
    display.setCursor(2, 12);display.println("DL=" + String(darts_launched) + " ATDL=" + String(data.all_time_darts_launched));
    display.setCursor(2, 23);display.println(String(SERIAL_NUMBER) + "  " + String(SOFTWARE_VERSION));
    display.setCursor(2, 34);display.println("Made by Valkor"); 
    if (data.failed_login_attempts > 0){
      display.setCursor(2, 45);display.println("FLA=" + String(data.failed_login_attempts)); 
    }
    display.display();
  }//display_stats

};//oled